## Update_project/sdkconfig.defaults
```kconfig
CONFIG_IDF_TARGET="esp32p4"
CONFIG_ESP32P4_SELECTS_REV_LESS_V3=y
CONFIG_ESP32P4_REV_MIN_100=y
CONFIG_ESPTOOLPY_FLASHMODE_QIO=y
CONFIG_ESPTOOLPY_FLASHSIZE_16MB=y
CONFIG_PARTITION_TABLE_CUSTOM=y
CONFIG_PARTITION_TABLE_CUSTOM_FILENAME="partitions.csv"
CONFIG_PARTITION_TABLE_OFFSET=0x8000
CONFIG_COMPILER_OPTIMIZATION_PERF=y
CONFIG_SPIRAM=y
CONFIG_SPIRAM_SPEED_200M=y
CONFIG_SPIRAM_XIP_FROM_PSRAM=y
# CONFIG_SPIRAM_MEMTEST is not set
CONFIG_CACHE_L2_CACHE_256KB=y
CONFIG_CACHE_L2_CACHE_LINE_128B=y
CONFIG_FREERTOS_TASK_CREATE_ALLOW_EXT_MEM=y
CONFIG_FREERTOS_HZ=1000
CONFIG_IDF_EXPERIMENTAL_FEATURES=y

CONFIG_BSP_I2C_NUM=1
CONFIG_BSP_I2C_FAST_MODE=y
CONFIG_BSP_LCD_COLOR_FORMAT_RGB565=y
CONFIG_BSP_LCD_DPI_BUFFER_NUMS=1
# CONFIG_BSP_SD_FORMAT_ON_MOUNT_FAIL is not set
CONFIG_BSP_SD_MOUNT_POINT="/sdcard"

CONFIG_FATFS_VOLUME_COUNT=8
CONFIG_FATFS_LFN_HEAP=y
CONFIG_FATFS_MAX_LFN=255
CONFIG_FATFS_API_ENCODING_UTF_8=y
CONFIG_FATFS_CODEPAGE_437=y
CONFIG_FATFS_EXFAT=y
CONFIG_FATFS_PER_FILE_CACHE=y
CONFIG_FATFS_USE_FASTSEEK=y
CONFIG_FATFS_FAST_SEEK_BUFFER_SIZE=64
CONFIG_FATFS_USE_STRFUNC_WITHOUT_CRLF_CONV=y
CONFIG_FATFS_PRINT_LLI=y
CONFIG_FATFS_PRINT_FLOAT=y
CONFIG_FATFS_STRF_ENCODE_UTF8=y
CONFIG_FATFS_IMMEDIATE_FSYNC=y
CONFIG_FATFS_USE_LABEL=y
CONFIG_FATFS_USE_DYN_BUFFERS=y
CONFIG_FATFS_ALLOC_PREFER_EXTRAM=y
```
